## meta-axiado-sdk/conf/machine/include/ax3000-intern.inc
```bitbake
PREFERRED_VERSION_u-boot-axiado = "2020.04+dev"
PREFERRED_VERSION_linux-axiado = "6.6.16+dev"
PREFERRED_VERSION_logmgr = "1.0+dev"
PREFERRED_VERSION_provision-native = "1.0+dev"
PREFERRED_VERSION_sysproxy = "1.0+dev"
PREFERRED_VERSION_tdfu = "1.0+dev"
PREFERRED_VERSION_bmc-pb = "1.0+dev"
```

## meta-axiado-sdk/conf/machine/include/ax3000.inc
```bitbake
SOC_FAMILY = "axiado-ax3000"
include conf/machine/include/soc-family.inc
include conf/machine/include/arm/arch-arm64.inc

UBOOT_ENTRYPOINT ?= "0x3E000000"
UBOOT_LOADADDRESS ?= "0x3E000000"
UBOOT_DTB_LOADADDRESS ?= "0x40000000"

PREFERRED_PROVIDER_virtual/kernel ?= "linux-axiado"
PREFERRED_VERSION_linux-axiado ?= "6.6.106+git"
PREFERRED_PROVIDER_virtual/bootloader ?= "u-boot-axiado"
PREFERRED_PROVIDER_u-boot ?= "u-boot-axiado"
PREFERRED_VERSION_u-boot-axiado ?= "2019.04+git"
PREFERRED_PROVIDER_u-boot-fw-utils ?= "libubootenv"

COMPATIBLE_MACHINE:axiado-ax3000 = "axiado-ax3000"

require conf/machine/include/axiado.inc
```

## meta-axiado-sdk/conf/machine/include/ax3005-intern.inc
```bitbake
PREFERRED_VERSION_u-boot-axiado = "2026.04+dev"
PREFERRED_VERSION_linux-axiado = "6.18.20+dev"
PREFERRED_VERSION_logmgr = "1.0+dev"
PREFERRED_VERSION_kw-hal = "1.0+dev"
PREFERRED_VERSION_caliptra-sw = "1.2.4+dev"
PREFERRED_VERSION_bmc-pb = "1.0+dev"
PREFERRED_VERSION_secureboot-image = "1.0+dev"
```

## meta-axiado-sdk/conf/machine/include/ax3005.inc
```bitbake
SOC_FAMILY = "axiado-ax3005"
include conf/machine/include/soc-family.inc
include conf/machine/include/arm/arch-arm64.inc

UBOOT_ENTRYPOINT ?= "0x95C00000"
UBOOT_LOADADDRESS ?= "0x95C00000"
UBOOT_DTB_LOADADDRESS ?= "0x99C00000"

PREFERRED_PROVIDER_virtual/kernel ?= "linux-axiado"
PREFERRED_VERSION_linux-axiado ?= "6.18.20+git"
PREFERRED_PROVIDER_virtual/bootloader ?= "u-boot-axiado"
PREFERRED_PROVIDER_u-boot ?= "u-boot-axiado"
PREFERRED_VERSION_u-boot-axiado ?= "2026.04+git"
PREFERRED_PROVIDER_u-boot-fw-utils ?= "libubootenv"

COMPATIBLE_MACHINE:axiado-ax3005 = "axiado-ax3005"

require conf/machine/include/axiado.inc
```

## meta-axiado-sdk/conf/machine/include/axiado-ax3005.inc
```bitbake
# Copyright (c) 2021-26 Axiado Corporation (or its affiliates). All rights reserved.

require conf/machine/include/obmc-bsp-common.inc
require conf/distro/include/pldm.inc

IMAGE_BOOT_FILES = "fitImage"
FLASH_KERNEL_IMAGE = "fitImage"

FLASH_UBOOT_OFFSET = "0"
FLASH_UBOOT_ENV_OFFSET = "1024"
FLASH_KERNEL_OFFSET = "1024"
FLASH_ROFS_OFFSET = "11264"
FLASH_RWFS_OFFSET = "65535"

WKS_FILE ?= "emmc-ax3005-sdk.wks.in"
WKS_FILE_DEPENDS:append = " virtual/bootloader"
IMAGE_FSTYPES += "wic.xz"

IMAGE_CLASSES += "image_types_ax3005"
```

## meta-axiado-sdk/conf/machine/include/axiado-dbg.inc
```bitbake
# Copyright (c) 2021-26 Axiado Corporation (or its affiliates). All rights reserved.

KERNEL_IMAGETYPE ?= "Image"
FLASH_KERNEL_IMAGE ?= "Image"
INITRAMFS_IMAGE = "core-image-minimal"
INITRAMFS_MAXSIZE = "631072"
INITRAMFS_CTYPE ?= "xz"
INITRAMFS_FSTYPES = "cpio.${INITRAMFS_CTYPE}"
IMAGE_FSTYPES = "${INITRAMFS_FSTYPES}"

CORE_IMAGE_EXTRA_INSTALL += "axiado-eip-firmware ax-net iptables iproute2 net-tools"
CORE_IMAGE_EXTRA_INSTALL += "dropbear xz"

inherit extrausers
DEFAULT_OPENBMC_PASSWORD = "'\$6\$UGMqyqdG\$GqTb3tXPFx9AJlzTw/8X5RoW2Z.100dT.acuk8AFJfNQYr.ZRL8itMIgLqsdq46RNHgiv78XayOSl.IbR4DFU.'"
EXTRA_USERS_PARAMS = "usermod -p ${DEFAULT_OPENBMC_PASSWORD} root;"
```

## meta-axiado-sdk/conf/machine/include/axiado-dev.inc
```bitbake
# Copyright (c) 2021-26 Axiado Corporation (or its affiliates). All rights reserved.

WKS_FILE ?= "emmc-axiado.wks.in"
# FIT images are built by the linux-yocto-fitimage recipe
WKS_FILE_DEPENDS ?= "virtual/bootloader virtual/kernel linux-yocto-fitimage"

IMAGE_BOOT_FILES ?= "fitImage"
FLASH_KERNEL_IMAGE ?= "fitImage"

FLASH_UBOOT_OFFSET = "0"

require conf/distro/include/phosphor-mmc.inc
require conf/machine/include/obmc-bsp-common.inc
```

## meta-axiado-sdk/conf/machine/include/axiado-prod.inc
```bitbake
# Copyright (c) 2021-26 Axiado Corporation (or its affiliates). All rights reserved.

WKS_FILE ?= "emmc-axiado-sdk.wks.in"
# FIT images are built by the linux-yocto-fitimage recipe
WKS_FILE_DEPENDS ?= "virtual/bootloader virtual/kernel linux-yocto-fitimage"

IMAGE_BOOT_FILES ?= "fitImage"
FLASH_KERNEL_IMAGE ?= "fitImage"

DISTROOVERRIDES .= ":axiado-provision"

IMAGE_CLASSES += "image_types_ax3000"

require conf/distro/include/phosphor-mmc.inc
require conf/machine/include/obmc-bsp-common.inc
```

## meta-axiado-sdk/meta-evb/meta-ax3000-evk/conf/machine/evk-axiado-github.conf
```bitbake
KERNEL_DEVICETREE = "axiado/ax3000-scm3003-evk.dtb"
KERNEL_DEVICETREE += "axiado/ax3000-scm3002-evk.dtb"
KERNEL_DEVICETREE += "axiado/ax3080-evk.dtb"
KERNEL_DEVICETREE += "axiado/scm3080-mt-evk.dtb"

UBOOT_MACHINE ?= "ax3000_evk_defconfig"
KBUILD_DEFCONFIG ?= "ax3000_defconfig"

require conf/machine/include/ax3000.inc
require conf/machine/include/obmc-evb-common.inc

PREFERRED_VERSION_u-boot-axiado = "2019.04+git"
PREFERRED_VERSION_linux-axiado = "6.6.106+git"
PREFERRED_VERSION_sysproxy = "0.1"
PREFERRED_VERSION_tdfu = "0.1"
PREFERRED_VERSION_provision = "0.1"
PREFERRED_VERSION_logmgr = "0.1"

WKS_FILE = "emmc-evk-axiado.wks.in"

FLASH_SIZE = "65535"
SERIAL_CONSOLES = "115200;ttyPS3"

OBMC_COMPATIBLE_NAMES = "ax3000"
EXTENDED_VERSION = "${DISTRO_VERSION}"

# Install Kernel modules
MACHINE_EXTRA_RRECOMMENDS = "kernel-modules"

IMAGE_FEATURES:remove = " \
    obmc-chassis-mgmt \
    obmc-chassis-state-mgmt \
    obmc-fan-control \
    obmc-fan-mgmt \
    obmc-host-ipmi \
    obmc-host-state-mgmt \
"

VIRTUAL-RUNTIME_obmc-inventory-manager = "entity-manager"
VIRTUAL-RUNTIME_obmc-sensors-hwmon = "dbus-sensors"
```

## meta-axiado-sdk/meta-evb/meta-ax3000-evk/conf/machine/evk-axiado.conf
```bitbake
KERNEL_DEVICETREE = "axiado/axiado-evk-mt2.dtb"
KERNEL_DEVICETREE += "axiado/axiado-evk-sb2.dtb"
KERNEL_DEVICETREE += "axiado/ax3080a1s_hv2.dtb"
KERNEL_DEVICETREE += "axiado/mts2.dtb"

UBOOT_MACHINE ?= "ax3000_evk_defconfig"
KBUILD_DEFCONFIG ?= "axiado_defconfig"

require conf/machine/include/ax3000.inc
require conf/machine/include/ax3000-intern.inc
require conf/machine/include/obmc-evb-common.inc

WKS_FILE = "emmc-evk-axiado.wks.in"

FLASH_SIZE = "65535"
SERIAL_CONSOLES = "115200;ttyPS3"

OBMC_COMPATIBLE_NAMES = "ax3000"
EXTENDED_VERSION = "${DISTRO_VERSION}"

# Install Kernel modules
MACHINE_EXTRA_RRECOMMENDS = "kernel-modules"

IMAGE_FEATURES:remove = " \
    obmc-chassis-mgmt \
    obmc-chassis-state-mgmt \
    obmc-fan-control \
    obmc-fan-mgmt \
    obmc-host-ipmi \
    obmc-host-state-mgmt \
    obmc-ikvm \
"
IMAGE_FEATURES += "package-management"

VIRTUAL-RUNTIME_obmc-inventory-manager = "entity-manager"
VIRTUAL-RUNTIME_obmc-sensors-hwmon = "dbus-sensors"

# Fix sysproxy build error
DEBUG_PREFIX_MAP:remove = "-fcanon-prefix-map"
```

## meta-axiado-sdk/meta-evb/meta-ax3000-qemu/conf/machine/evk-axiado-qemu.conf
```bitbake
KERNEL_DEVICETREE = "axiado/ax3000-scm3003-qemu.dtb"

UBOOT_MACHINE ?= "ax3000_evk_defconfig"
KBUILD_DEFCONFIG ?= "ax3000_defconfig"

BUILD_VAR ?= "dev"

require conf/machine/include/ax3000.inc
require conf/machine/include/obmc-evb-common.inc

KERNEL_IMAGETYPE += "Image"
IMAGE_FSTYPES += "wic.qcow2"
WKS_FILE = "emmc-evk-axiado.wks.in"

FLASH_SIZE = "65535"
SERIAL_CONSOLES = "115200;ttyPS3"

OBMC_COMPATIBLE_NAMES = "ax3000"
EXTENDED_VERSION = "${DISTRO_VERSION}"

IMAGE_FEATURES:remove = " \
    obmc-chassis-mgmt \
    obmc-chassis-state-mgmt \
    obmc-fan-control \
    obmc-fan-mgmt \
    obmc-host-ipmi \
    obmc-host-state-mgmt \
"

VIRTUAL-RUNTIME_obmc-inventory-manager = "entity-manager"
VIRTUAL-RUNTIME_obmc-sensors-hwmon = "dbus-sensors"
```

## meta-axiado-sdk/meta-evb/meta-ax3005-evk/conf/machine/evk-ax3005-github.conf
```bitbake
KERNEL_DEVICETREE = "axiado/ax3005-evk.dtb"
KERNEL_DEVICETREE += "axiado/scm3005-mt-evk.dtb"

UBOOT_MACHINE ?= "ax3005_scm3005_defconfig"
KBUILD_DEFCONFIG ?= "ax3005_defconfig"

BUILD_VAR ?= "ax3005"

require conf/machine/include/ax3005.inc
require conf/machine/include/obmc-evb-common.inc
require conf/distro/include/pldm.inc

WKS_FILE = "emmc-evk-ax3005.wks.in"

FLASH_SIZE = "65535"
SERIAL_CONSOLES = "115200;ttyPS3"

EXTENDED_VERSION = "${DISTRO_VERSION}"

IMAGE_FEATURES:remove = " \
    obmc-chassis-mgmt \
    obmc-chassis-state-mgmt \
    obmc-fan-control \
    obmc-fan-mgmt \
    obmc-host-ipmi \
    obmc-host-state-mgmt \
    obmc-ikvm \
"
IMAGE_FEATURES += "package-management"

USE_CALIPTRA_DUMMY_KEYS = "1"

VIRTUAL-RUNTIME_obmc-inventory-manager = "entity-manager"
VIRTUAL-RUNTIME_obmc-sensors-hwmon = "dbus-sensors"
```

## meta-axiado-sdk/meta-evb/meta-ax3005-fvp/conf/machine/ax3005-fvp.conf
```bitbake
KERNEL_DEVICETREE = "axiado/ax3005-fvp.dtb"

UBOOT_MACHINE ?= "ax3005_evk_defconfig"
KBUILD_DEFCONFIG ?= "ax3005_defconfig"

BUILD_VAR ?= "ax3005"

require conf/machine/include/ax3005.inc
require conf/machine/include/ax3005-intern.inc
require conf/machine/include/obmc-evb-common.inc
require conf/distro/include/pldm.inc

WKS_FILE = "emmc-evk-ax3005.wks.in"

FLASH_SIZE = "65535"
SERIAL_CONSOLES = "115200;ttyPS3"

EXTENDED_VERSION = "${DISTRO_VERSION}"

USE_CALIPTRA_DUMMY_KEYS = "1"

VIRTUAL-RUNTIME_obmc-inventory-manager = "entity-manager"
VIRTUAL-RUNTIME_obmc-sensors-hwmon = "dbus-sensors"

IMAGE_FEATURES:remove = "obmc-health-monitor"
IMAGE_FEATURES:remove = "obmc-leds"
IMAGE_FEATURES:remove = "obmc-fan-control"
IMAGE_FEATURES:remove = "obmc-fan-mgmt"
IMAGE_FEATURES:remove = "obmc-ikvm"
```

## meta-axiado-sdk/meta-evb/meta-ax3005-fvp/meta-common/conf/layer.conf
```bitbake
BBPATH .= ":${LAYERDIR}"

BBFILES += "\
${LAYERDIR}/recipes-*/*/*.bb \
${LAYERDIR}/recipes-*/*/*.bbappend \
"

BBFILE_COLLECTIONS += "common"
BBFILE_PATTERN_common = "^${LAYERDIR}/"
LAYERSERIES_COMPAT_common = "wrynose whinlatter"
```

## meta-axiado-sdk/meta-evb/meta-ax3005-qemu/conf/machine/evk-ax3005-qemu.conf
```bitbake
KERNEL_DEVICETREE = "axiado/ax3005-evb-qemu.dtb"

UBOOT_MACHINE ?= "ax3005_scm3005_defconfig"
KBUILD_DEFCONFIG ?= "ax3005_defconfig"

BUILD_VAR ?= "ax3005"

require conf/machine/include/ax3005.inc
require conf/machine/include/obmc-evb-common.inc

IMAGE_CLASSES:remove = "image_types_ax3005"

WKS_FILE = "emmc-evk-ax3005.wks.in"

FLASH_SIZE = "65535"
SERIAL_CONSOLES = "115200;ttyPS3"

EXTENDED_VERSION = "${DISTRO_VERSION}"

IMAGE_FEATURES:remove = " \
    obmc-chassis-mgmt \
    obmc-chassis-state-mgmt \
    obmc-fan-control \
    obmc-fan-mgmt \
    obmc-host-ipmi \
    obmc-host-state-mgmt \
    obmc-ikvm \
"

VIRTUAL-RUNTIME_obmc-inventory-manager = "entity-manager"
VIRTUAL-RUNTIME_obmc-sensors-hwmon = "dbus-sensors"
```
