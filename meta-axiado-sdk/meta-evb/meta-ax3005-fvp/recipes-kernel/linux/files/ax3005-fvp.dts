// SPDX-License-Identifier: GPL-2.0+
/*
 * DTS file for FVP model of Axiado AX3005 SoC Evaluation board
 */

/dts-v1/;

#include "ax3005_evk.dts"

/ {
	model = "Axiado AX3005 FVP";

	lstp: lstp {
		compatible = "nvidia,lstp";
		#address-cells = <1>;
		#size-cells = <0>;

		channel@0 {
			reg = <0>;
			nvidia,channel-type = "management";
			nvidia,channel-name = "AXIADO_AX3005_LSTP_BR";
		};
	};
};

&usb2_0 {
	compatible = "axiado,ax3000-udc";
};
